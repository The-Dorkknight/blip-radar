// Blip — one small ESP32, one RD-03D radar, and an old phone as the screen.
// Required Notice: Copyright Matthew Armstrong (https://github.com/The-Dorkknight)
// Licensed under the PolyForm Noncommercial License 1.0.0. No warranty.
//
// WORK IN PROGRESS: MANY FEATURES MAY BE BROKEN. Since v0.2.0-wip this firmware
// compiles for both boards (checked in the author's build sandbox), but it has
// NOT yet been run on real hardware. The parser and the audio DSP are
// unit-tested natively and the web UI is tested against tools/sim_radar.py.
//
// What it does:
//   * reads the RD-03D over UART1 at 256000 baud, decodes 3 tracked targets
//   * runs its own Wi-Fi hotspot + captive portal, serves the web UI from flash
//   * pushes targets over a WebSocket (and /api/targets for polling)
//   * optionally mirrors a mini scope on a 128x32 or 128x64 SSD1306 OLED
//   * optionally samples a CW Doppler module's IF ("Stetho") at 8 kHz, cleans
//     it up (bump gate, emphasis, noise suppression, AGC) and plays it to the
//     phone, 3.5 mm earphones (delta-sigma) or an I2S amp board
//
// Project started 2026-11-05 10:24.
#include <Arduino.h>
#include <WiFi.h>
#include <DNSServer.h>
#include <AsyncTCP.h>
#include <ESPAsyncWebServer.h>
#include <Preferences.h>
#include <math.h>
#include <esp_system.h>
#include <esp_heap_caps.h>

#include "config.h"
#include "rd03d.h"
#include "oled.h"
#include "tracker.h"
#include "gate.h"
#include "stetho.h"
#include "blip_log.h"
#include "lab.h"
#include "web_ui.h"   // generated by tools/embed_web.py from web/index.html

// ---------------------------------------------------------------------------
// Globals
// ---------------------------------------------------------------------------
static const char* BUILD_DATE = __DATE__ " " __TIME__;

HardwareSerial radarSerial(1);
rd03d::Parser  parser;
rd03d::Frame   frame;              // latest decoded frame, straight from the module
rd03d::Frame   shown;              // what the phone/OLED get: raw frame, or the Smart tracker's view
uint16_t       shownIds[rd03d::MAX_TARGETS];
blip_track::Tracker tracker;       // experimental "Smart" filter
blip_gate::Gate gate;              // minimum range / edge limit / handheld mode, before Raw or Smart
struct Dropped { int16_t x, y; uint8_t why; };
Dropped        gateDrop[rd03d::MAX_TARGETS]; uint8_t gateDropN = 0;   // what the gate removed last frame (phone overlay)
uint32_t       prevFrameMs = 0;
uint32_t       lastFrameMs = 0;    // when it arrived
uint32_t       frameCount1s = 0, fps = 0, fpsWindowStart = 0;
bool           radarPowered = true;
bool           stethoPowered = true;
bool           radarAsleep = false, stethoAsleep = false;   // auto-sleep states
uint32_t       lastWatchedMs = 0, lastHeardMs = 0;          // last time someone was looking / listening
uint8_t        cmdStep = 0; uint32_t cmdStepMs = 0;         // non-blocking mode-command sequence

static const size_t STATUS_BUF = 2048;   // status JSON (was 1400; the Lab and timing fields need the room)

AsyncWebServer server(80);
AsyncWebSocket ws("/ws");
DNSServer      dns;
Preferences    prefs;
Oled           oled;
Stetho         stetho;

volatile bool labRestart = false;
volatile bool labClearStats = false; // Lab: zero the audio-task timing counters    // Lab: audio task priority / sample source changed, restart Stetho in loop()
volatile bool oledPending = false;   // display re-init requested from a web request; applied in loop()

volatile uint32_t httpReqs = 0, probeReqs = 0;   // page/API requests, captive-portal probes + unknown URLs
volatile bool txpPending = false;
uint32_t stethoSent = 0;             // Stetho packets queued to every phone (diagnostics)
static uint32_t loopStartUs = 0, loopMaxUs = 0, loopMaxShownUs = 0;   // loop() timing for the health line
uint32_t stethoSkipped = 0;          // ... that at least one phone's full queue refused
volatile bool stethoPending = false; // start/stop/retune requested from a web request; applied in loop()

struct Settings {
  bool     multi;      // true = multi-target mode (default), false = single
  uint8_t  oled;       // OledKind
  bool     stetho;     // sample + process + stream the Doppler IF channel
  StethoSettings st;   // DSP preset, suppression, AGC, local audio output
  bool     radarOff;   // switch the RD-03D off while listening (needs PIN_RADAR_PWR)
  uint8_t  filter;     // 0 = raw module output, 1 = Smart tracker (experimental)
  uint8_t  sleepMin;   // auto-sleep after this many minutes unwatched / unheard; 0 = never
  uint8_t  txp;        // Wi-Fi transmit power: 0 = 8.5 dBm, 1 = 15 dBm, 2 = 19.5 dBm
  uint8_t  minRangeCm; // ignore contacts closer than this (10 = old behaviour)
  uint8_t  edgeDeg;    // ignore contacts beyond ±this many degrees (65 = old behaviour)
  bool     handheld;   // radar is being carried: hide fixed scenery, don't learn clutter
  bool     strictGhost;// Smart filter: + track-correlation ghost test
  uint8_t  stuckS;     // drop a target frozen at identical x,y for this long (s), 0 = off
  char     ssid[33];
  char     pass[65];
} cfg;

// ---------------------------------------------------------------------------
// Settings (NVS)
// ---------------------------------------------------------------------------
#if CONFIG_IDF_TARGET_ESP32C3
#define TXP_DEFAULT 0
#else
#define TXP_DEFAULT 1
#endif

static void loadSettings() {
  prefs.begin("blip", true);
  cfg.multi  = prefs.getBool("multi", true);
  cfg.oled   = prefs.getUChar("oled", OLED_AUTO);
  cfg.stetho = prefs.getBool("stetho", false);
  cfg.st.dsp.preset       = prefs.getUChar("preset", blipdsp::HEART);
  cfg.st.dsp.nsStrength   = prefs.getUChar("ns", 60);
  cfg.st.dsp.bumpSens     = prefs.getUChar("bump", 50);
  cfg.st.dsp.agc          = prefs.getBool("agc", true);
  cfg.st.dsp.maxGainDb    = prefs.getUChar("maxg", 36);
  cfg.st.dsp.manualGainDb = prefs.getUChar("mang", 12);
  cfg.st.out              = prefs.getUChar("out", OUT_NONE);
  cfg.st.outVol           = prefs.getUChar("ovol", 60);
  cfg.radarOff            = prefs.getBool("radarOff", false);
  cfg.filter              = prefs.getUChar("filter", 0);
  cfg.sleepMin            = prefs.getUChar("sleep", 0);
  cfg.txp                 = prefs.getUChar("txp", TXP_DEFAULT);
  cfg.minRangeCm          = constrain(prefs.getUChar("minr", 10), 10, 150);
  cfg.edgeDeg             = constrain(prefs.getUChar("edge", 65), 20, 65);
  cfg.handheld            = prefs.getBool("hand", false);
  cfg.strictGhost         = prefs.getBool("sghost", false);
  cfg.stuckS              = constrain(prefs.getUChar("stuck", 10), 0, 120);
  String s = prefs.getString("ssid", AP_SSID_DEFAULT);
  String p = prefs.getString("pass", AP_PASS_DEFAULT);
  prefs.end();
  strlcpy(cfg.ssid, s.c_str(), sizeof cfg.ssid);
  strlcpy(cfg.pass, p.c_str(), sizeof cfg.pass);
}

static void saveSettings() {
  prefs.begin("blip", false);
  prefs.putBool("multi", cfg.multi);
  prefs.putUChar("oled", cfg.oled);
  prefs.putBool("stetho", cfg.stetho);
  prefs.putUChar("preset", cfg.st.dsp.preset);
  prefs.putUChar("ns", cfg.st.dsp.nsStrength);
  prefs.putUChar("bump", cfg.st.dsp.bumpSens);
  prefs.putBool("agc", cfg.st.dsp.agc);
  prefs.putUChar("maxg", cfg.st.dsp.maxGainDb);
  prefs.putUChar("mang", cfg.st.dsp.manualGainDb);
  prefs.putUChar("out", cfg.st.out);
  prefs.putUChar("ovol", cfg.st.outVol);
  prefs.putBool("radarOff", cfg.radarOff);
  prefs.putUChar("filter", cfg.filter);
  prefs.putUChar("sleep", cfg.sleepMin);
  prefs.putUChar("txp", cfg.txp);
  prefs.putUChar("minr", cfg.minRangeCm);
  prefs.putUChar("edge", cfg.edgeDeg);
  prefs.putBool("hand", cfg.handheld);
  prefs.putBool("sghost", cfg.strictGhost);
  prefs.putUChar("stuck", cfg.stuckS);
  prefs.putString("ssid", cfg.ssid);
  prefs.putString("pass", cfg.pass);
  prefs.end();
}

// ---------------------------------------------------------------------------
// Radar
// ---------------------------------------------------------------------------
// Start the enable-config → mode → end-config sequence; radarCmdTick() sends
// one step every 200 ms from loop(), so nothing blocks and the web task never
// touches the UART. Frames pause for ~0.6 s while it runs.
static void radarSendMode() {
#if RADAR_LD2450
  cmdStep = 0;                                  // the LD2450 has no RD-03D mode commands; Single is done in firmware
#else
  cmdStep = 1; cmdStepMs = millis() - 200;
#endif
}

static void radarCmdTick() {
  if (!cmdStep || millis() - cmdStepMs < 200) return;
  switch (cmdStep) {
    case 1: radarSerial.write(rd03d::CMD_ENABLE_CONFIG, sizeof rd03d::CMD_ENABLE_CONFIG); break;
    case 2: radarSerial.write(cfg.multi ? rd03d::CMD_MULTI_TARGET : rd03d::CMD_SINGLE_TARGET, 12); break;
    case 3: radarSerial.write(rd03d::CMD_END_CONFIG, sizeof rd03d::CMD_END_CONFIG); break;
    default: cmdStep = 0; return;                  // the parser resyncs on the next AA FF 03 00 by itself
  }
  cmdStepMs = millis();
  cmdStep++;
}

static void radarBegin() {
  radarSerial.setRxBufferSize(1024);
  radarSerial.begin(RADAR_BAUD, SERIAL_8N1, PIN_RADAR_RX, PIN_RADAR_TX);
  delay(100);
  radarSendMode();
}

static bool radarWanted() { return !(cfg.stetho && cfg.radarOff) && !radarAsleep; }

static bool radarAlive() { return radarPowered && lastFrameMs && (millis() - lastFrameMs) < 1500; }

// Optional high-side switch on the radar's 5 V (see config.h).
static void radarPower(bool on) {
#if PIN_RADAR_PWR >= 0
  if (on == radarPowered) return;
  digitalWrite(PIN_RADAR_PWR, on ? HIGH : LOW);
  radarPowered = on;
  tracker.reset();
  if (on) { radarSendMode(); cmdStepMs = millis(); }     // re-send the mode once it has booted (first step after 200 ms)
#else
  (void)on;
#endif
}

// Settings -> gate + tracker options (cheap; called every frame so a change applies at once)
static void applyFilterCfg() {
  gate.cfg.minMm = (uint16_t)cfg.minRangeCm * 10;
  gate.cfg.maxDeg = cfg.edgeDeg;
  gate.cfg.handheld = cfg.handheld;
  gate.cfg.stuckS = cfg.stuckS;
  tracker.cfg.noClutter = cfg.handheld;
  tracker.cfg.strictGhost = cfg.strictGhost;
}

static void radarPoll() {
  while (radarSerial.available()) {
    uint8_t b = (uint8_t)radarSerial.read();
    if (parser.feed(b, frame)) {
      uint32_t t = millis();
      float gdt = prevFrameMs ? (t - prevFrameMs) / 1000.0f : 0.05f;
      applyFilterCfg();
      rd03d::Frame before = frame;
      gate.apply(frame, gdt);
      gateDropN = 0;
      for (int i = 0; i < rd03d::MAX_TARGETS; i++)
        if (before.t[i].present && gate.why(i) != blip_gate::KEEP)
          gateDrop[gateDropN++] = {before.t[i].x_mm, before.t[i].y_mm, (uint8_t)gate.why(i)};
      if (!cfg.multi) rd03d::keep_nearest(frame);   // Single mode: the LD2450 always sends three, so pick here
      if (cfg.filter == 1) {
        float dt = prevFrameMs ? (t - prevFrameMs) / 1000.0f : 0.05f;
        tracker.update(frame, dt);
        tracker.visible(shown, shownIds);
      } else {
        shown = frame;
        for (int i = 0; i < rd03d::MAX_TARGETS; i++) shownIds[i] = i + 1;
      }
      prevFrameMs = lastFrameMs = t;
      frameCount1s++;
    }
  }
  uint32_t now = millis();
  if (now - fpsWindowStart >= 1000) { fps = frameCount1s; frameCount1s = 0; fpsWindowStart = now; }
}

// ---------------------------------------------------------------------------
// JSON builders (no library: tiny, predictable, fits the phone's needs)
// ---------------------------------------------------------------------------
static size_t targetsJson(char* out, size_t cap) {
  size_t n = snprintf(out, cap, "{\"ms\":%lu,\"alive\":%s,\"fps\":%lu,\"f\":\"%s\",\"sleep\":%s,\"t\":[",
                      (unsigned long)millis(), radarAlive() ? "true" : "false", (unsigned long)fps,
                      cfg.filter == 1 ? "smart" : "raw", radarAsleep ? "true" : "false");
  bool first = true;
  for (int i = 0; i < rd03d::MAX_TARGETS; i++) {
    const rd03d::Target& t = shown.t[i];
    if (!t.present || !radarAlive()) continue;
    float d = sqrtf((float)t.x_mm * t.x_mm + (float)t.y_mm * t.y_mm);
    float a = atan2f((float)t.x_mm, (float)t.y_mm) * 180.0f / (float)M_PI;   // + = left
    n += snprintf(out + n, cap - n, "%s{\"id\":%d,\"x\":%d,\"y\":%d,\"v\":%d,\"res\":%u,\"d\":%.0f,\"a\":%.1f}",
                  first ? "" : ",", shownIds[i], t.x_mm, t.y_mm, t.v_cms, t.res_mm, d, a);
    first = false;
    if (n >= cap - 2) break;
  }
  n += snprintf(out + n, cap - n, "]");
  if (radarAlive() && gateDropN) {                  // what the gate dropped (any mode), for the overlay
    n += snprintf(out + n, cap - n, ",\"g\":[");
    static const char* WHY[5] = {"", "near", "edge", "scenery", "stuck"};
    for (int i = 0; i < gateDropN && n < cap - 50; i++)
      n += snprintf(out + n, cap - n, "%s{\"x\":%d,\"y\":%d,\"why\":\"%s\"}", i ? "," : "", gateDrop[i].x, gateDrop[i].y, WHY[gateDrop[i].why > 4 ? 0 : gateDrop[i].why]);
    n += snprintf(out + n, cap - n, "]");
  }
  if (cfg.handheld && radarAlive()) n += snprintf(out + n, cap - n, ",\"ego\":%.0f", gate.ego());
  if (cfg.filter == 1 && radarAlive()) {             // what the Smart filter is hiding, for the phone's overlay
    n += snprintf(out + n, cap - n, ",\"h\":[");
    bool f2 = true;
    for (int i = 0; i < blip_track::MAX_TRACKS && n < cap - 60; i++) {
      const blip_track::Track& k = tracker.track(i);
      if (!k.used || (k.st != blip_track::GHOST && k.st != blip_track::CLUTTER)) continue;
      n += snprintf(out + n, cap - n, "%s{\"id\":%u,\"x\":%.0f,\"y\":%.0f,\"why\":\"%s\"}", f2 ? "" : ",",
                    k.id, k.x, k.y, k.st == blip_track::GHOST ? "ghost" : "clutter");
      f2 = false;
    }
    n += snprintf(out + n, cap - n, "]");
  }
  n += snprintf(out + n, cap - n, "}");
  return n;
}

// Why the chip last (re)started, and how many starts since power-up: a node that
// keeps crashing shows reason "panic"/"task watchdog" and a growing count.
static RTC_NOINIT_ATTR uint32_t bootMagic;
static RTC_NOINIT_ATTR uint32_t bootCount;
static const char* resetReasonName() {
  switch (esp_reset_reason()) {
    case ESP_RST_POWERON: return "power on";
    case ESP_RST_SW: return "software restart";
    case ESP_RST_PANIC: return "crash (panic)";
    case ESP_RST_INT_WDT: return "crash (interrupt watchdog)";
    case ESP_RST_TASK_WDT: return "crash (task watchdog)";
    case ESP_RST_WDT: return "crash (watchdog)";
    case ESP_RST_BROWNOUT: return "brown-out (power dip)";
    case ESP_RST_DEEPSLEEP: return "deep sleep";
    case ESP_RST_USB: return "USB";
    default: return "other";
  }
}

// snprintf onto the end of a JSON buffer, clamped: n never runs past cap, so a long
// status line can't turn "cap - n" into a huge number (a buffer overrun).
static size_t jcat(char* out, size_t cap, size_t n, const char* fmt, ...) __attribute__((format(printf, 4, 5)));
static size_t jcat(char* out, size_t cap, size_t n, const char* fmt, ...) {
  if (n >= cap) return cap - 1;
  va_list ap; va_start(ap, fmt);
  int m = vsnprintf(out + n, cap - n, fmt, ap);
  va_end(ap);
  if (m < 0) return n;
  n += (size_t)m;
  return n >= cap ? cap - 1 : n;
}

static size_t statusJson(char* out, size_t cap) {
  size_t n = snprintf(out, cap,
    "{\"app\":\"Blip\",\"version\":\"%s\",\"build\":\"%s\",\"board\":\"%s\",\"boardId\":\"%s\","
    "\"wip\":true,\"ssid\":\"%s\",\"ip\":\"%s\",\"clients\":%d,"
    "\"radar\":{\"alive\":%s,\"fps\":%lu,\"frames\":%lu,\"bad\":%lu,\"mode\":\"%s\",\"model\":\"%s\",\"baud\":%d,\"powered\":%s,\"pwrPin\":%d,\"offWhileListening\":%s,\"filter\":\"%s\",\"asleep\":%s,\"minr\":%u,\"edge\":%u,\"hand\":%s,\"sghost\":%s,\"stuck\":%u},"
    "\"oled\":%u,\"sleepMin\":%u,\"txp\":%u,",
    BLIP_VERSION, BUILD_DATE, BLIP_BOARD, BLIP_BOARD_ID,
    cfg.ssid, WiFi.softAPIP().toString().c_str(), WiFi.softAPgetStationNum(),
    radarAlive() ? "true" : "false", (unsigned long)fps, (unsigned long)parser.frames(), (unsigned long)parser.bad(),
    cfg.multi ? "multi" : "single", RADAR_LD2450 ? "ld2450" : "rd03d", RADAR_BAUD, radarPowered ? "true" : "false", PIN_RADAR_PWR, cfg.radarOff ? "true" : "false",
    cfg.filter == 1 ? "smart" : "raw", radarAsleep ? "true" : "false",
    cfg.minRangeCm, cfg.edgeDeg, cfg.handheld ? "true" : "false", cfg.strictGhost ? "true" : "false", cfg.stuckS,
    cfg.oled, cfg.sleepMin, cfg.txp);
  if (n >= cap) n = cap - 1;
  const blipdsp::Params& d = cfg.st.dsp;
  int lmn, lavg, lmx; stetho.level(lmn, lavg, lmx);
  n = jcat(out, cap, n,
    "\"stetho\":{\"enabled\":%s,\"running\":%s,\"rate\":%d,\"frame\":%d,\"pinI\":%d,"
    "\"preset\":\"%s\",\"ns\":%u,\"bump\":%u,\"agc\":%s,\"maxgain\":%u,\"gain\":%u,"
    "\"out\":%u,\"ovol\":%u,\"outs\":{\"earphone\":%s,\"amp\":%s},\"overruns\":%lu,\"dropped\":%lu,\"pwrPin\":%d,\"asleep\":%s,"
    "\"err\":\"%s\",\"samples\":%lu,\"invalid\":%lu,\"sent\":%lu,\"skipped\":%lu,\"level\":{\"min\":%d,\"avg\":%d,\"max\":%d,\"mv\":%s}},",
    cfg.stetho ? "true" : "false", stetho.running() ? "true" : "false", blipdsp::FS, STETHO_AUDIO_FRAME, PIN_STETHO_I,
    blipdsp::PRESETS[d.preset].id, d.nsStrength, d.bumpSens, d.agc ? "true" : "false", d.maxGainDb, d.manualGainDb,
    cfg.st.out, cfg.st.outVol, PIN_PDM_OUT >= 0 ? "true" : "false", PIN_I2S_DOUT >= 0 ? "true" : "false",
    (unsigned long)stetho.overruns(), (unsigned long)stetho.dropped(), PIN_STETHO_PWR, stethoAsleep ? "true" : "false",
    stetho.error(), (unsigned long)stetho.samples(), (unsigned long)stetho.invalid(), (unsigned long)stethoSent, (unsigned long)stethoSkipped,
    lmn, lavg, lmx, stetho.levelInMv() ? "true" : "false");
  // Timing the audio task measured on the node itself, and the Lab switches
  n = jcat(out, cap, n,
    "\"stetho2\":{\"blocks\":%lu,\"dspUs\":%lu,\"dspUsMax\":%lu,\"gapMaxMs\":%lu,\"rdTimeouts\":%lu,\"rdErrs\":%lu},"
    "\"lab\":{\"pace\":%u,\"dsp\":%u,\"send\":%u,\"text\":%u,\"src\":%u,\"prio\":%u,\"quiet\":%u,\"skip\":%u,\"os\":%u,\"nb\":%u},",
    (unsigned long)stetho.blocks(), (unsigned long)stetho.dspUsAvg(), (unsigned long)stetho.dspUsMax(), (unsigned long)stetho.gapMaxMs(),
    (unsigned long)stetho.readTimeouts(), (unsigned long)stetho.readErrs(),
    lab::f.pace, lab::f.dsp, lab::f.send, lab::f.text, lab::f.src, lab::f.prio, lab::f.quiet, lab::f.skip, lab::f.os, lab::f.nb);
  n = jcat(out, cap, n,
    "\"node\":{\"heap\":%lu,\"heapMin\":%lu,\"loopMs\":%lu,\"up\":%lu,\"oledFound\":%s,\"reset\":\"%s\",\"boots\":%lu},"
    "\"pins\":{\"radarRx\":%d,\"radarTx\":%d,\"sda\":%d,\"scl\":%d,\"adc\":%d,\"i2sBclk\":%d,\"i2sWs\":%d,\"i2sDout\":%d,\"pdm\":%d,\"radarPwr\":%d}}",
    (unsigned long)ESP.getFreeHeap(), (unsigned long)ESP.getMinFreeHeap(), (unsigned long)(loopMaxShownUs / 1000), (unsigned long)(millis() / 1000),
    oled.found() ? "true" : "false", resetReasonName(), (unsigned long)bootCount,
    PIN_RADAR_RX, PIN_RADAR_TX, PIN_OLED_SDA, PIN_OLED_SCL, PIN_STETHO_I, PIN_I2S_BCLK, PIN_I2S_WS, PIN_I2S_DOUT, PIN_PDM_OUT, PIN_RADAR_PWR);
  return n;
}

// ---------------------------------------------------------------------------
// Web
// ---------------------------------------------------------------------------
// Optional high-side switch on the CDM324/HB100's 5 V (see config.h).
static void stethoPower(bool on) {
#if PIN_STETHO_PWR >= 0
  if (on == stethoPowered) return;
  digitalWrite(PIN_STETHO_PWR, on ? HIGH : LOW);
  stethoPowered = on;
#else
  (void)on;
#endif
}

// Runs in loop() (never in the web task: stopping waits for the audio task).
static void applyStetho() {
  bool want = cfg.stetho && !stethoAsleep;
  if (want) {
    bool wasOff = !stethoPowered;
    stethoPower(true);
    if (!stetho.running()) {
      if (wasOff) delay(50);                         // let the oscillator start
      if (!stetho.start(cfg.st)) blog::logf("Stetho: could not start on GPIO%d: %s", PIN_STETHO_I, stetho.error());
      else blog::logf("Stetho: sampling GPIO%d at %d Hz (%lu KB free)", PIN_STETHO_I, blipdsp::FS, (unsigned long)(ESP.getFreeHeap() / 1024));
      stetho.mute(600);                              // hide the power-on thump while the DC tracker settles
    } else stetho.apply(cfg.st);
  } else {
    if (stetho.running()) blog::logf("Stetho: stopped");
    stetho.stop();
    stethoPower(false);
  }
  radarPower(radarWanted());
}

// Auto-sleep: nobody has looked at the radar (no phone, no OLED) or listened
// to the Stetho (no phone, no node output) for cfg.sleepMin minutes → power
// that radar down (needs the matching *_PWR pin; without it only the
// processing stops). A phone joining the hotspot wakes everything.
static void sleepTick() {
  uint32_t now = millis();
  bool phone = ws.count() > 0;
  if (phone || cfg.oled != OLED_NONE) lastWatchedMs = now;
  if (phone || cfg.st.out != OUT_NONE) lastHeardMs = now;
  uint32_t limit = (uint32_t)cfg.sleepMin * 60000UL;
  bool rs = cfg.sleepMin && now - lastWatchedMs > limit;
  bool ss = cfg.sleepMin && cfg.stetho && now - lastHeardMs > limit;
  if (rs != radarAsleep) { radarAsleep = rs; radarPower(radarWanted()); blog::logf("radar %s", rs ? "asleep" : "awake"); }
  if (ss != stethoAsleep) { stethoAsleep = ss; applyStetho(); blog::logf("Stetho %s", ss ? "asleep" : "awake"); }
}

static uint8_t presetFromName(const String& v) {
  for (int i = 0; i < blipdsp::NPRESETS; i++) if (v == blipdsp::PRESETS[i].id) return i;
  return (uint8_t)constrain(v.toInt(), 0, blipdsp::NPRESETS - 1);
}

static void sendIndex(AsyncWebServerRequest* r) {
  httpReqs++;
  AsyncWebServerResponse* resp = r->beginResponse(200, "text/html", WEB_INDEX_GZ, WEB_INDEX_GZ_LEN);
  resp->addHeader("Content-Encoding", "gzip");
  resp->addHeader("Cache-Control", "no-cache");
  r->send(resp);
}

static void redirectHome(AsyncWebServerRequest* r) {
  probeReqs++;
  AsyncWebServerResponse* resp = r->beginResponse(302, "text/plain", "");
  resp->addHeader("Location", String("http://") + WiFi.softAPIP().toString() + "/");
  r->send(resp);
}

static void onWsEvent(AsyncWebSocket* srv, AsyncWebSocketClient* client, AwsEventType type,
                      void* arg, uint8_t* data, size_t len) {
  (void)data; (void)len;
  if (type == WS_EVT_CONNECT) {
    client->client()->setNoDelay(true);      // send small audio packets now, don't batch them (Nagle)
    static char buf[STATUS_BUF]; statusJson(buf, sizeof buf);   // static: web-task stack stays small (one web task)
    client->text(buf);
    blog::logf("page #%lu connected from %s, %u page(s) open", (unsigned long)client->id(), client->remoteIP().toString().c_str(), (unsigned)srv->count());
  } else if (type == WS_EVT_DISCONNECT) {
    blog::logf("page #%lu disconnected", (unsigned long)client->id());
  } else if (type == WS_EVT_ERROR) {
    blog::logf("page #%lu error %u", (unsigned long)client->id(), arg ? *(uint16_t*)arg : 0);
  }
}

static void webBegin() {
  ws.onEvent(onWsEvent);
  server.addHandler(&ws);

  server.on("/", HTTP_GET, sendIndex);
  server.on("/index.html", HTTP_GET, sendIndex);

  server.on("/api/status", HTTP_GET, [](AsyncWebServerRequest* r) {
    httpReqs++;
    static char buf[STATUS_BUF]; statusJson(buf, sizeof buf);
    r->send(200, "application/json", buf);
  });
  server.on("/api/targets", HTTP_GET, [](AsyncWebServerRequest* r) {
    char buf[1200]; targetsJson(buf, sizeof buf);
    r->send(200, "application/json", buf);
  });
  // Settings: /api/config?mode=multi|single&oled=0|1|2|3(auto)&minr=10..150(cm)&edge=20..65&hand=0|1&sghost=0|1&stuck=0..120(s)&stetho=0|1&ssid=..&pass=..
  server.on("/api/config", HTTP_ANY, [](AsyncWebServerRequest* r) {
    bool wifiChanged = false;
    if (r->hasParam("mode"))   { cfg.multi = r->getParam("mode")->value() != "single"; radarSendMode(); }
    if (r->hasParam("oled"))   { cfg.oled = (uint8_t)r->getParam("oled")->value().toInt(); if (cfg.oled > 3) cfg.oled = 0; oledPending = true; }
    if (r->hasParam("stetho")) { cfg.stetho = r->getParam("stetho")->value().toInt() != 0; stethoPending = true; }
    blipdsp::Params& d = cfg.st.dsp;
    auto num = [&](const char* k, int lo, int hi, int cur) { return r->hasParam(k) ? constrain((int)r->getParam(k)->value().toInt(), lo, hi) : cur; };
    if (r->hasParam("preset")) d.preset = presetFromName(r->getParam("preset")->value());
    d.nsStrength   = num("ns", 0, 100, d.nsStrength);
    d.bumpSens     = num("bump", 0, 100, d.bumpSens);
    d.maxGainDb    = num("maxgain", 0, 48, d.maxGainDb);
    d.manualGainDb = num("gain", 0, 48, d.manualGainDb);
    if (r->hasParam("agc"))  d.agc = r->getParam("agc")->value().toInt() != 0;
    cfg.st.out    = num("out", 0, 2, cfg.st.out);
    cfg.st.outVol = num("ovol", 0, 100, cfg.st.outVol);
    if (r->hasParam("radarOff")) cfg.radarOff = r->getParam("radarOff")->value().toInt() != 0;
    if (r->hasParam("filter")) { cfg.filter = r->getParam("filter")->value() == "smart" ? 1 : 0; tracker.reset(); }
    if (r->hasParam("forget")) tracker.forgetClutter();
    if (r->hasParam("minr"))   cfg.minRangeCm = constrain((int)r->getParam("minr")->value().toInt(), 10, 150);
    if (r->hasParam("edge"))   cfg.edgeDeg = constrain((int)r->getParam("edge")->value().toInt(), 20, 65);
    if (r->hasParam("hand"))   { cfg.handheld = r->getParam("hand")->value().toInt() != 0; gate.reset(); tracker.reset(); }
    if (r->hasParam("stuck"))  { cfg.stuckS = constrain((int)r->getParam("stuck")->value().toInt(), 0, 120); gate.reset(); }
    if (r->hasParam("sghost")) { cfg.strictGhost = r->getParam("sghost")->value().toInt() != 0; tracker.reset(); }
    if (r->hasParam("sleep"))  { cfg.sleepMin = constrain((int)r->getParam("sleep")->value().toInt(), 0, 60); lastWatchedMs = lastHeardMs = millis(); stethoPending = true; }
    if (r->hasParam("preset") || r->hasParam("ns") || r->hasParam("bump") || r->hasParam("maxgain") || r->hasParam("gain") ||
        r->hasParam("agc") || r->hasParam("out") || r->hasParam("ovol") || r->hasParam("radarOff")) stethoPending = true;
    if (r->hasParam("ssid"))   { String s = r->getParam("ssid")->value(); if (s.length() >= 1 && s.length() <= 32) { strlcpy(cfg.ssid, s.c_str(), sizeof cfg.ssid); wifiChanged = true; } }
    if (r->hasParam("pass"))   { String p = r->getParam("pass")->value(); if (p.length() >= 8 && p.length() <= 63) { strlcpy(cfg.pass, p.c_str(), sizeof cfg.pass); wifiChanged = true; } }
    if (r->hasParam("txp"))    { cfg.txp = constrain((int)r->getParam("txp")->value().toInt(), 0, 2); txpPending = true; }
    saveSettings();
    httpReqs++;
    static char buf[STATUS_BUF]; statusJson(buf, sizeof buf);
    r->send(200, "application/json", buf);
    if (wifiChanged) {
      // New hotspot name/password take effect after a reboot so the phone
      // keeps this page long enough to read the confirmation.
      delay(300);
      ESP.restart();
    }
  });
  // Lab switches (see lab.h): /api/lab?pace=1&dsp=1&send=1&text=3&src=1&prio=3&quiet=1&skip=7&os=4&nb=1  |  ?reset=1  |  ?clear=1 (timing stats)
  server.on("/api/lab", HTTP_ANY, [](AsyncWebServerRequest* r) {
    auto num = [&](const char* k, int lo, int hi, uint8_t cur) -> uint8_t { return r->hasParam(k) ? (uint8_t)constrain((int)r->getParam(k)->value().toInt(), lo, hi) : cur; };
    uint8_t oldSrc = lab::f.src, oldPrio = lab::f.prio; int oldOs = lab::osFactor();
    if (r->hasParam("reset") && r->getParam("reset")->value().toInt()) lab::f = lab::Flags();
    lab::f.pace  = num("pace", 0, 2, lab::f.pace);
    lab::f.dsp   = num("dsp", 0, 2, lab::f.dsp);
    lab::f.send  = num("send", 0, 2, lab::f.send);
    lab::f.text  = num("text", 0, 3, lab::f.text);
    lab::f.src   = num("src", 0, 1, lab::f.src);
    lab::f.prio  = num("prio", 1, 24, lab::f.prio);
    lab::f.quiet = num("quiet", 0, 1, lab::f.quiet);
    lab::f.skip  = num("skip", 0, 7, lab::f.skip);
    lab::f.os    = num("os", 0, 8, lab::f.os);
    lab::f.nb    = num("nb", 0, 1, lab::f.nb);
    blog::quiet = lab::f.quiet != 0;
    if (lab::f.src != oldSrc || lab::f.prio != oldPrio || lab::osFactor() != oldOs) labRestart = true;
    if (r->hasParam("clear")) labClearStats = true;
    httpReqs++;
    static char buf[STATUS_BUF]; statusJson(buf, sizeof buf);
    r->send(200, "application/json", buf);
    blog::logf("Lab: pace %u dsp %u send %u text %u src %u prio %u quiet %u skip %u os %u nb %u", lab::f.pace, lab::f.dsp, lab::f.send, lab::f.text, lab::f.src, lab::f.prio, lab::f.quiet, lab::f.skip, lab::f.os, lab::f.nb);
  });
  // The node log (survives crashes and restarts, not power cuts)
  server.on("/api/log", HTTP_GET, [](AsyncWebServerRequest* r) {
    static char lb[blog::LOG_SIZE + 1];
    blog::copy(lb, sizeof lb);
    AsyncWebServerResponse* resp = r->beginResponse(200, "text/plain; charset=utf-8", lb);
    resp->addHeader("Cache-Control", "no-store");
    r->send(resp);
  });
  server.on("/api/reboot", HTTP_ANY, [](AsyncWebServerRequest* r) { r->send(200, "text/plain", "rebooting"); delay(200); ESP.restart(); });

  // Captive-portal probes from Android / iOS / Windows
  server.on("/generate_204", HTTP_GET, redirectHome);
  server.on("/gen_204", HTTP_GET, redirectHome);
  server.on("/hotspot-detect.html", HTTP_GET, redirectHome);
  server.on("/library/test/success.html", HTTP_GET, redirectHome);
  server.on("/connecttest.txt", HTTP_GET, redirectHome);
  server.on("/ncsi.txt", HTTP_GET, redirectHome);
  server.on("/redirect", HTTP_GET, redirectHome);
  server.onNotFound(redirectHome);

  server.begin();
}

// Wi-Fi transmit power. ESP32-C3 Super Mini boards have a poor antenna match:
// at full power many phones struggle to join or drop out, and the current
// spikes can brown out a weak USB supply. 8.5 dBm is the well-known fix there
// (and was for Skipper Flipper); S3 boards default to 15 dBm.
static const wifi_power_t TXP_LEVELS[3] = {WIFI_POWER_8_5dBm, WIFI_POWER_15dBm, WIFI_POWER_19_5dBm};
static const char* TXP_NAMES[3] = {"8.5", "15", "19.5"};
static void applyTxPower() {
  if (cfg.txp > 2) cfg.txp = TXP_DEFAULT;
  WiFi.setTxPower(TXP_LEVELS[cfg.txp]);
  blog::logf("Wi-Fi transmit power %s dBm", TXP_NAMES[cfg.txp]);
}

// Who joins and leaves the hotspot, and why (reason codes: 2 = auth expired,
// 4/15 = inactivity/handshake timeout, 8 = left, 200+ = beacon/handshake).
static void onWifiEvent(arduino_event_id_t e, arduino_event_info_t info) {
  switch (e) {
    case ARDUINO_EVENT_WIFI_AP_STACONNECTED: {
      const uint8_t* m = info.wifi_ap_staconnected.mac;
      blog::logf("Wi-Fi: device ..%02X:%02X joined (aid %u), %d on the hotspot", m[4], m[5], info.wifi_ap_staconnected.aid, WiFi.softAPgetStationNum());
      break;
    }
    case ARDUINO_EVENT_WIFI_AP_STADISCONNECTED: {
      const uint8_t* m = info.wifi_ap_stadisconnected.mac;
      blog::logf("Wi-Fi: device ..%02X:%02X left, reason %u, %d on the hotspot", m[4], m[5], info.wifi_ap_stadisconnected.reason, WiFi.softAPgetStationNum());
      break;
    }
    case ARDUINO_EVENT_WIFI_AP_STAIPASSIGNED:
      blog::logf("Wi-Fi: gave out %s", IPAddress(info.wifi_ap_staipassigned.ip.addr).toString().c_str());
      break;
    default: break;
  }
}

static void wifiBegin() {
  WiFi.onEvent(onWifiEvent);
  WiFi.persistent(false);
  WiFi.mode(WIFI_AP);
  WiFi.softAPConfig(IPAddress(192, 168, 4, 1), IPAddress(192, 168, 4, 1), IPAddress(255, 255, 255, 0));
  WiFi.softAP(cfg.ssid, cfg.pass, AP_CHANNEL, 0, AP_MAX_CLIENTS);
  WiFi.setSleep(false);                       // no modem power-save: it adds tens of ms to every packet
  applyTxPower();
  dns.setErrorReplyCode(DNSReplyCode::NoError);
  dns.start(53, "*", WiFi.softAPIP());
}

// ---------------------------------------------------------------------------
// Arduino entry points
// ---------------------------------------------------------------------------
static uint32_t lastWsMs = 0, lastLedMs = 0, lastStatusPushMs = 0, lastHealthMs = 0;
static uint32_t lastTargetsFrames = 0;


// Fires the instant ANY heap allocation fails, anywhere in the firmware or a
// library (AsyncTCP, lwIP, ...). Logs the size, memory-type and the calling
// function so a sudden crash has a concrete "who asked for what" right
// before it, instead of just a watchdog panic with no lead. No heap use here.
static void onAllocFailed(size_t size, uint32_t caps, const char* fn) {
  blog::logf("ALLOC FAILED: %u bytes (caps 0x%lx) in %s (%lu KB free, biggest block %lu)", (unsigned)size, (unsigned long)caps, fn,
             (unsigned long)(ESP.getFreeHeap() / 1024), (unsigned long)(heap_caps_get_largest_free_block(MALLOC_CAP_8BIT) / 1024));
}

void setup() {
  if (bootMagic != 0xB11B0001u || esp_reset_reason() == ESP_RST_POWERON) { bootMagic = 0xB11B0001u; bootCount = 0; }
  bootCount++;
  heap_caps_register_failed_alloc_callback(onAllocFailed);
  Serial.begin(115200);
#if defined(CONFIG_IDF_TARGET_ESP32S3) && !ARDUINO_USB_CDC_ON_BOOT
  usbLog().setTxTimeoutMs(0);      // S3 boards wired to the chip's own USB (no CH343): copy the log there too, never block
  usbLog().begin();
#endif
#if ARDUINO_USB_CDC_ON_BOOT && ARDUINO_USB_MODE
  Serial.setTxTimeoutMs(0);     // USB serial: never wait for a PC that isn't reading
#endif
  delay(200);
  blog::begin(esp_reset_reason() != ESP_RST_POWERON);
  Serial.println();
  blog::logf("=== Blip %s built %s on %s, start #%lu, last reset: %s ===", BLIP_VERSION, BUILD_DATE, BLIP_BOARD,
             (unsigned long)bootCount, resetReasonName());

#if PIN_STATUS_LED >= 0
  pinMode(PIN_STATUS_LED, OUTPUT);
#endif
#if PIN_RADAR_PWR >= 0
  pinMode(PIN_RADAR_PWR, OUTPUT);
  digitalWrite(PIN_RADAR_PWR, HIGH);
#endif
#if PIN_STETHO_PWR >= 0
  pinMode(PIN_STETHO_PWR, OUTPUT);
  digitalWrite(PIN_STETHO_PWR, LOW);               // applyStetho() switches it on if Stetho is enabled
  stethoPowered = false;
#endif
  loadSettings();
  wifiBegin();
  radarBegin();
  oled.begin((OledKind)cfg.oled);
  applyStetho();
  webBegin();
  blog::logf("hotspot '%s' on channel %d -> http://%s/  (%lu KB free)", cfg.ssid, AP_CHANNEL, WiFi.softAPIP().toString().c_str(),
             (unsigned long)(ESP.getFreeHeap() / 1024));
}

void loop() {
  loopStartUs = micros();
  if (!(lab::f.skip & 4)) dns.processNextRequest();
  if (!(lab::f.skip & 1)) { radarCmdTick(); radarPoll(); }
  sleepTick();
  ws.cleanupClients();

  uint32_t now = millis();

  // Targets to the phone(s)
  bool fresh = parser.frames() != lastTargetsFrames;
  if (!(lab::f.text & 1) && ws.count() > 0 && ((fresh && now - lastWsMs >= WS_TARGET_RATE_MS) || now - lastWsMs >= 1000)) {
    lastWsMs = now; lastTargetsFrames = parser.frames();
    char buf[1200]; size_t n = targetsJson(buf, sizeof buf);
    ws.textAll(buf, n);
  }

  // Status (incl. Stetho diagnostics) pushed every 2 s, so the page doesn't
  // have to open a new HTTP connection every second to ask for it.
  if (!(lab::f.text & 2) && ws.count() > 0 && now - lastStatusPushMs >= 2000) {
    lastStatusPushMs = now;
    static char sb[STATUS_BUF]; size_t sn = statusJson(sb, sizeof sb);
    ws.textAll(sb, sn);
  }

  // Stetho settings changed on the web page
  if (labRestart) { labRestart = false; if (stetho.running()) stetho.stop(); stethoPending = true; }   // Lab: new source / priority
  if (labClearStats) { labClearStats = false; stetho.clearStats(); loopMaxUs = 0; loopMaxShownUs = 0; }
  if (stethoPending) { stethoPending = false; applyStetho(); }

  // Stetho packets to the phone(s). This is the 0.2.2-pre send logic that ran
  // for minutes on a real C3, put back as an A/B test: the latency rework
  // called ws.binaryAll() on every packet and let a small (8) queue refuse
  // them, which kept loopTask inside AsyncWebSocket's client/queue locks and
  // lwIP's tcp_write dozens of times a second — the same locks async_tcp
  // needs, and where the decoded crash found loopTask. So again: only send
  // when every phone's queue has room (availableForWriteAll), only the newest
  // two packets per pass, and throw away a backlog of six (~190 ms) so audio
  // stays fresh rather than late. Packets stay mu-law / 32 ms.
  if (stetho.running()) {
    static uint8_t pk[6][PKT_HDR + AUDIO_FRAME];
    static size_t pl[6];
    int got = 0;
    while (got < 6 && (pl[got] = stetho.nextAudioPacket(pk[got], sizeof pk[got])) > 0) got++;
    if (got == 6) stetho.flushAudio();
    uint8_t vb[PKT_HDR + VITALS_FRAME * 2]; size_t vl;
    if (lab::f.send == 1) {                                 // Lab: audio drained and thrown away, nothing sent
      while (stetho.nextVitalsPacket(vb, sizeof vb) > 0) {}
    } else if (lab::f.send == 2) {                          // Lab: every packet straight into binaryAll(), no room check
      if (ws.count() > 0) {
        for (int i = 0; i < got; i++) { ws.binaryAll(pk[i], pl[i]); stethoSent++; }
        while ((vl = stetho.nextVitalsPacket(vb, sizeof vb)) > 0) ws.binaryAll(vb, vl);
      } else {
        while (stetho.nextVitalsPacket(vb, sizeof vb) > 0) {}
      }
    } else if (ws.count() > 0) {
      for (int i = (got > 2 ? got - 2 : 0); i < got; i++) {
        if (!ws.availableForWriteAll()) { stethoSkipped += got - i; break; }
        ws.binaryAll(pk[i], pl[i]);
        stethoSent++;
      }
      if (got > 2) stethoSkipped += got - 2;
      while ((vl = stetho.nextVitalsPacket(vb, sizeof vb)) > 0) if (ws.availableForWriteAll()) ws.binaryAll(vb, vl);
    } else {
      while (stetho.nextVitalsPacket(vb, sizeof vb) > 0) {}
    }
  }

  // Node health for the Stetho tab: slowest loop() pass and free memory
  uint32_t passUs = micros() - loopStartUs;
  if (passUs > loopMaxUs) loopMaxUs = passUs;
  if (now - lastHealthMs >= 5000) { lastHealthMs = now; loopMaxShownUs = loopMaxUs; loopMaxUs = 0; }
  // A single pass over 150 ms would already explain a missed watchdog
  // check-in on its own; log it the instant it happens, not at the next
  // health tick, so a stall shows up even if the reset comes first.
  static uint32_t lastSlowLogMs = 0;
  if (passUs > 150000 && now - lastSlowLogMs >= 500) {
    lastSlowLogMs = now;
    blog::logf("SLOW LOOP: one pass took %lu ms (heap %lu KB)", (unsigned long)(passUs / 1000), (unsigned long)(ESP.getFreeHeap() / 1024));
  }

  // Health line in the node log every 10 s: memory (free, lowest, biggest
  // block), who is connected, request counts and the Stetho numbers, so a slow
  // leak or a Wi-Fi drop can be read back from /api/log after the fact.
  // While Stetho is running, every 1 s instead: the last two crashes happened
  // 4-9 s after Stetho started, too fast for a 10 s line to ever catch
  // more than one reading before the reset.
  static uint32_t lastHealthLogMs = 0, lastHttp = 0, lastProbe = 0, lastSent = 0, lastSkip = 0, lastDrop = 0;
  static bool lowWarned = false;
  uint32_t healthEveryMs = (cfg.stetho && stetho.running()) ? 1000 : 10000;
  if (now - lastHealthLogMs >= healthEveryMs) {
    lastHealthLogMs = now;
    uint32_t heap = ESP.getFreeHeap();
    char st[200] = "Stetho off";
    if (cfg.stetho) {
      int a, b, c; stetho.level(a, b, c);
      snprintf(st, sizeof st, "Stetho %s %d mV, +%lu sent +%lu skipped +%lu dropped, block %lu/%lu us, gap max %lu ms, read timeouts %lu",
               stetho.running() ? "on" : (stethoAsleep ? "asleep" : "NOT running"),
               b, (unsigned long)(stethoSent - lastSent), (unsigned long)(stethoSkipped - lastSkip), (unsigned long)(stetho.dropped() - lastDrop),
               (unsigned long)stetho.dspUsAvg(), (unsigned long)stetho.dspUsMax(), (unsigned long)stetho.gapMaxMs(), (unsigned long)stetho.readTimeouts());
    }
    // async_tcp's own state: if it ever stops checking in with the watchdog,
    // this is the one thing a loopTask-only crash dump can't show — whether
    // it was genuinely busy (Running/Ready, pegging the CPU) or stuck waiting
    // on something that never arrived (Blocked), at the last health tick
    // before a crash. "?" if the library hasn't started that task yet.
    char tcpSt[40] = "async_tcp ?";
    if (TaskHandle_t h = xTaskGetHandle("async_tcp")) {
      static const char* NAMES[] = {"Running", "Ready", "Blocked", "Suspended", "Deleted", "Invalid"};
      eTaskState st2 = eTaskGetState(h);
      snprintf(tcpSt, sizeof tcpSt, "async_tcp %s, stack free %u", (st2 >= 0 && st2 <= eInvalid) ? NAMES[st2] : "?",
               (unsigned)uxTaskGetStackHighWaterMark(h));
    }
    blog::logf("health: %lu KB free (lowest %lu, biggest block %lu) | %d on hotspot, %u page(s) | +%lu requests +%lu probes | loop %lu ms | %s | %s",
               (unsigned long)(heap / 1024), (unsigned long)(ESP.getMinFreeHeap() / 1024),
               (unsigned long)(heap_caps_get_largest_free_block(MALLOC_CAP_8BIT) / 1024), WiFi.softAPgetStationNum(), (unsigned)ws.count(),
               (unsigned long)(httpReqs - lastHttp), (unsigned long)(probeReqs - lastProbe), (unsigned long)(loopMaxShownUs / 1000), st, tcpSt);
    lastHttp = httpReqs; lastProbe = probeReqs; lastSent = stethoSent; lastSkip = stethoSkipped; lastDrop = stetho.dropped();
    if (heap < 40 * 1024 && !lowWarned) { lowWarned = true; blog::logf("WARNING: memory low (%lu KB free)", (unsigned long)(heap / 1024)); }
    if (heap > 60 * 1024) lowWarned = false;
  }
  if (txpPending) { txpPending = false; applyTxPower(); }

  // OLED mirror (re-init here, not in the web task, so I2C is only touched from loop())
  if (oledPending) { oledPending = false; oled.begin((OledKind)cfg.oled); }
  if (!(lab::f.skip & 2)) oled.draw(shown, radarAlive(), radarAsleep, cfg.filter == 1, WiFi.softAPgetStationNum(), WiFi.softAPIP().toString().c_str());

  // Status LED: slow blink = waiting for radar, fast blink = frames flowing
#if PIN_STATUS_LED >= 0
  uint32_t period = radarAlive() ? 150 : 1000;
  if (now - lastLedMs >= period) {
    lastLedMs = now;
    static bool on = false; on = !on;
    digitalWrite(PIN_STATUS_LED, (on ^ STATUS_LED_INVERTED) ? HIGH : LOW);
  }
#endif

  // Lab: pace the loop. 0 (shipped) = free-running; the bench test, which survives, sleeps 1 ms per pass.
  if (lab::f.pace == 1) delay(1);
  else if (lab::f.pace == 2) delay(10);
}
